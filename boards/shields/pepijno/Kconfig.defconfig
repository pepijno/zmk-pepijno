## boards/shields/pepijno/Kconfig.defconfig
```kconfig
if SHIELD_PEPIJNO_LEFT

config ZMK_KEYBOARD_NAME
    default "pepijno"

config ZMK_SPLIT_ROLE_CENTRAL
    default y

endif

if SHIELD_PEPIJNO_LEFT || SHIELD_PEPIJNO_RIGHT
config ZMK_SPLIT
    default y
endif

if ZMK_DISPLAY
config ZMK_WIDGET_WPM_STATUS
    default n
# config ZMK_WIDGET_BATTERY_STATUS
#     default y
config ZMK_WIDGET_BATTERY_STATUS_SHOW_PERCENTAGE
    default y
endif # ZMK_DISPLAY
```

## config/boards/shields/pepijno/Kconfig.defconfig
```kconfig
if SHIELD_PEPIJNO_LEFT

config ZMK_KEYBOARD_NAME
    default "pepijno"

config ZMK_SPLIT_ROLE_CENTRAL
    default y

endif

if SHIELD_PEPIJNO_LEFT || SHIELD_PEPIJNO_RIGHT
config ZMK_SPLIT
    default y
endif
```

## config/boards/shields/pepijno/Kconfig.shield
```kconfig
config SHIELD_PEPIJNO_LEFT
    def_bool $(shields_list_contains,pepijno_left)

config SHIELD_PEPIJNO_RIGHT
    def_bool $(shields_list_contains,pepijno_right)
```
