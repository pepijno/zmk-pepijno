/*
 * Copyright (c) 2022 The ZMK Contributors
 *
 * SPDX-License-Identifier: MIT
 */

#include <stdio.h>

printf("Test");

#include "../miryoku_zmk/miryoku/custom_config.h"
#include "../miryoku_zmk/miryoku/mapping/36/minidox.h"
#include "../miryoku_zmk/miryoku/miryoku.dtsi"
