/*
 * Copyright (c) 2023 The ZMK Contributors
 *
 * SPDX-License-Identifier: MIT
 */

#include "pepijno.dtsi"

&kscan0 {
        row-gpios
                = <&pro_micro 15 (GPIO_ACTIVE_HIGH | GPIO_PULL_DOWN)>
                , <&pro_micro 14 (GPIO_ACTIVE_HIGH | GPIO_PULL_DOWN)>
                , <&pro_micro 16 (GPIO_ACTIVE_HIGH | GPIO_PULL_DOWN)>
                , <&pro_micro 10 (GPIO_ACTIVE_HIGH | GPIO_PULL_DOWN)>
                ;
        col-gpios
                = <&pro_micro 9 GPIO_ACTIVE_HIGH>
                , <&pro_micro 8 GPIO_ACTIVE_HIGH>
                , <&pro_micro 7 GPIO_ACTIVE_HIGH>
                , <&pro_micro 6 GPIO_ACTIVE_HIGH>
                , <&pro_micro 5 GPIO_ACTIVE_HIGH>
                ;
};
